## Kconfig
```kconfig
mainmenu "Zeal 8-bit OS Configuration"

    config CPU_FREQ
        int "CPU Clock Frequency (Hz)"
        default 10000000
        help
            Defines the CPU frequency in Hz, this may be used for counting time when no hardware timer
            is available.

    config TARGET
        string
        default "zeal8bit" if TARGET_ZEAL_8_BIT
        default "trs80" if TARGET_TRS_80
        default "agon" if TARGET_AGON_LIGHT
        default "z80mini" if TARGET_Z80_MINI

    choice COMPILATION_TARGET
        prompt "Target board"
        help
            Choose the compilation target.

        config TARGET_ZEAL_8_BIT
            bool
            prompt "Zeal 8-bit computer"
            help
                Compile for Zeal 8-bit computer.

        config TARGET_TRS_80
            bool
            prompt "TRS-80 Model I"
            help
                Compile for TRS-80 Model I.

        config TARGET_AGON_LIGHT
            bool
            prompt "Agon Light"
            help
                Compile for Agon Light.

        config TARGET_Z80_MINI
            bool
            prompt "Z80mini"
            help
                Compile for Z80mini.
    endchoice

    # Configuration options depending on the target
    if TARGET_ZEAL_8_BIT
        source "target/zeal8bit/Kconfig"
    endif

    if TARGET_TRS_80
        source "target/trs80/Kconfig"
    endif

    if TARGET_AGON_LIGHT
        source "target/agon/Kconfig"
    endif

    if TARGET_Z80_MINI
        source "target/z80mini/Kconfig"
    endif

    source "kernel/Kconfig"
    source "romdisk/Kconfig"
```
